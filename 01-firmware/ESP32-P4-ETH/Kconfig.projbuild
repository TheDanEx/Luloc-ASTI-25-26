## 01-firmware/ESP32-P4-ETH_uROS/sdkconfig.defaults
```kconfig
CONFIG_IDF_TARGET="esp32p4"

CONFIG_ESP_MAIN_TASK_STACK_SIZE=8192
CONFIG_ESP_TASK_WDT=n

# micro-ROS: Ethernet with internal EMAC + IP101 PHY (Waveshare ESP32-P4-ETH)
CONFIG_MICRO_ROS_ESP_NETIF_ENET=y
CONFIG_MICRO_ROS_USE_INTERNAL_ETHERNET=y
CONFIG_MICRO_ROS_TRANSPORT_UDP=y
CONFIG_MICRO_ROS_ETH_PHY_IP101=y
CONFIG_MICRO_ROS_ETH_MDC_GPIO=31
CONFIG_MICRO_ROS_ETH_MDIO_GPIO=52
CONFIG_MICRO_ROS_ETH_PHY_RST_GPIO=51
CONFIG_MICRO_ROS_ETH_PHY_ADDR=1

# Ethernet Clock Configuration (Critical for ESP32-P4 RMII)
CONFIG_ETH_ENABLED=y
CONFIG_ETH_USE_ESP32_EMAC=y
CONFIG_ETH_PHY_INTERFACE_RMII=y
CONFIG_ETH_RMII_CLK_INPUT=y
CONFIG_ETH_RMII_CLK_IN_GPIO=50

# Static IP (no DHCP available on the Pi 5 ethernet segment)
CONFIG_MICRO_ROS_ETH_STATIC_IP=y
CONFIG_MICRO_ROS_ETH_STATIC_IP_ADDR="192.168.5.2"
CONFIG_MICRO_ROS_ETH_STATIC_NETMASK="255.255.255.0"
CONFIG_MICRO_ROS_ETH_STATIC_GW="192.168.5.1"

# micro-ROS Agent running on Pi 5 (eth0 = 192.168.5.1)
CONFIG_MICRO_ROS_ESP_XRCE_DDS_MIDDLEWARE=y
CONFIG_MICRO_ROS_AGENT_IP="192.168.5.1"
CONFIG_MICRO_ROS_AGENT_PORT="8888"

# Hardware / Flashing fixes for Waveshare P4 (rev v1.3 / 16MB Flash)
CONFIG_ESPTOOLPY_FLASHSIZE_16MB=y
CONFIG_ESPTOOLPY_FLASHSIZE="16MB"
CONFIG_ESP32P4_SELECTS_REV_LESS_V3=y
CONFIG_ESP32P4_REV_MIN_100=y
CONFIG_ESP32P4_REV_MIN_FULL=100
CONFIG_ESP_REV_MIN_FULL=100
```

## 01-firmware/zESP32-P4-ETH/components/ina226_sensor/Kconfig
```kconfig
menu "Luloc-ASTI: 2. Sensors - INA226 Power Monitor"

    config INA226_I2C_PORT
        int "I2C Port Number"
        default 0
        help
            The I2C port used to communicate with the INA226.

    config INA226_I2C_SDA_PIN
        int "I2C SDA Pin"
        default 7
        help
            The GPIO mapped to the I2C Data line. 
            Default 7 for ESP32-P4.

    config INA226_I2C_SCL_PIN
        int "I2C SCL Pin"
        default 8
        help
            The GPIO mapped to the I2C Clock line.

    config INA226_I2C_CLOCK_SPEED_HZ
        int "I2C Clock Speed (Hz)"
        default 400000
        help
            I2C Bus speed. Default is 400kHz.

    config INA226_SHUNT_OHMS
        string "Shunt Resistor Value (Ohms)"
        default "0.01"
        help
            Value of the shunt resistor mounted on the INA226 board.
            For 4S LiPo with DC motors, 0.01 ohm for high current.

    config INA226_MAX_EXPECTED_AMPS
        string "Maximum Expected Amps (A)"
        default "10.0"
        help
            Used to calculate the internal LSB scaling for the INA226.
            For a 4S LiPo robot with 2 DC motors, up to 10A burst is realistic.

    config INA226_POLLING_RATE_HZ
        int "Polling Rate in LP Task (Hz)"
        default 5
        help
            How many times per second the low-power CPU reads the sensor
            and updates shared memory.

    config INA226_TELEMETRY_RATE_MS
        int "MQTT Telemetry Rate (ms)"
        default 1000
        help
            How often the batched data is physically transmitted over MQTT.

    config INA226_MQTT_TOPIC
        string "MQTT Telemetry Topic"
        default "robot/telemetry/power"
        help
            Topic name for the InfluxDB Line Protocol power payloads.

    menu "Power Alerts (Audible)"
        config INA226_ALERTS_ENABLED
            bool "Enable Audible Power Alerts"
            default y
            help
                Enable/Disable the battery low and overcurrent audio alerts.

        config INA226_ALERT_VOLTAGE_THRESHOLD_MV
            int "Low Voltage Threshold (mV)"
            default 14000
            help
                Alert when battery voltage drops below this value. 
                For 4S LiPo: 14000mV (3.5V/cell) is a safe warning level.

        config INA226_ALERT_CURRENT_THRESHOLD_MA
            int "High Current Threshold (mA)"
            default 8000
            help
                Alert when total current consumption exceeds this value.
                Useful to detect motor stalls or shorts.

        choice INA226_LOW_VOLTAGE_SOUND
            prompt "Sound for Low Voltage"
            default INA226_LOW_VOLTAGE_SOUND_BATTERY_LOW
            depends on INA226_ALERTS_ENABLED
            help
                Which sound to play when battery is low.

            config INA226_LOW_VOLTAGE_SOUND_BATTERY_LOW
                bool "BATTERY_LOW"
            config INA226_LOW_VOLTAGE_SOUND_STARTUP
                bool "STARTUP"
        endchoice

        choice INA226_HIGH_CURRENT_SOUND
            prompt "Sound for High Current"
            default INA226_HIGH_CURRENT_SOUND_BATTERY_LOW
            depends on INA226_ALERTS_ENABLED
            help
                Which sound to play when current is high.

            config INA226_HIGH_CURRENT_SOUND_BATTERY_LOW
                bool "BATTERY_LOW"
            config INA226_HIGH_CURRENT_SOUND_STARTUP
                bool "STARTUP"
        endchoice

    endmenu

endmenu
```

## 01-firmware/zESP32-P4-ETH/components/telemetry_manager/Kconfig
```kconfig
menu "Telemetry Configuration"

    config TELEMETRY_ROBOT_NAME
        string "Robot Name"
        default "Luloc"
        help
            The global name of the robot that will be added to all telemetry points as a tag (e.g., robot=Luloc).

endmenu
```

## 01-firmware/zESP32-P4-ETH/sdkconfig.defaults
```kconfig
CONFIG_ROBOT_CONTROL_PERIOD_MS=2
CONFIG_ROBOT_USE_ETHERNET=y
CONFIG_PARTITION_TABLE_CUSTOM=y
CONFIG_PARTITION_TABLE_CUSTOM_FILENAME="partitions.csv"
CONFIG_PARTITION_TABLE_FILENAME="partitions.csv"
CONFIG_ESPTOOLPY_FLASHSIZE_32MB=y

# Increase baud rate for faster flashing
CONFIG_ESPTOOLPY_BAUD=2000000
CONFIG_ESPTOOLPY_MONITOR_BAUD=2000000

# Performance Monitor Configuration
CONFIG_FREERTOS_GENERATE_RUN_TIME_STATS=y
CONFIG_FREERTOS_USE_TRACE_FACILITY=y
CONFIG_FREERTOS_USE_STATS_FORMATTING_FUNCTIONS=y
CONFIG_FREERTOS_VTASKLIST_INCLUDE_COREID=y

# Log Configuration - Default to WARN to suppress early boot noise
CONFIG_LOG_DEFAULT_LEVEL=2
CONFIG_BOOTLOADER_LOG_LEVEL_WARN=y

# Multicast Support for PTP
CONFIG_LWIP_IGMP=y

# FreeRTOS 1000 Hz Tick Rate for Real-Time 500Hz delays
CONFIG_FREERTOS_HZ=1000
```
