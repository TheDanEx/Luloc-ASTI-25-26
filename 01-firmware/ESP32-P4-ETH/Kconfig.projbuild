## 01-firmware/ESP32-P4-ETH/Kconfig.projbuild
```kconfig
menu "Robot Configuration"

config ROBOT_CONTROL_PERIOD_MS
    int "Control loop period (ms)"
    default 10

config ROBOT_USE_ETHERNET
    bool "Enable Ethernet"
    default y

endmenu

menu "Example Configuration"
    config EXAMPLE_ETH_DEINIT_AFTER_S
        int "Stop and deinit Ethernet after elapsing number of secs"
        range -1 300
        default -1
        help
            This option is for demonstration purposes only to demonstrate deinitialization of the Ethernet driver.
            Set to -1 to not deinitialize.
endmenu
```

## 01-firmware/ESP32-P4-ETH/components/ina219_sensor/Kconfig
```kconfig
menu "[UJI] 2. Sensors: INA219 Power Monitor"

    config INA219_I2C_PORT
        int "I2C Port Number"
        default 0
        help
            The I2C port used to communicate with the INA219.

    config INA219_I2C_SDA_PIN
        int "I2C SDA Pin"
        default 21
        help
            The GPIO mapped to the I2C Data line. 
            Default 21 for older ESP32s, ESP32-P4 might map differently.

    config INA219_I2C_SCL_PIN
        int "I2C SCL Pin"
        default 22
        help
            The GPIO mapped to the I2C Clock line.

    config INA219_I2C_CLOCK_SPEED_HZ
        int "I2C Clock Speed (Hz)"
        default 400000
        help
            I2C Bus speed. Default is 400kHz.

    config INA219_SHUNT_OHMS
        string "Shunt Resistor Value (Ohms)"
        default "0.01"
        help
            Value of the shunt resistor mounted on the INA219 board.
            Usually 0.1 ohm or 0.01 ohm for high current.

    config INA219_MAX_EXPECTED_AMPS
        string "Maximum Expected Amps (A)"
        default "3.2"
        help
            Used to calculate the internal LSB scaling for the INA219.

    config INA219_POLLING_RATE_HZ
        int "Polling Rate in LP Task (Hz)"
        default 5
        help
            How many times per second the low-power CPU reads the sensor
            and updates shared memory.

    config INA219_TELEMETRY_RATE_MS
        int "MQTT Telemetry Rate (ms)"
        default 1000
        help
            How often the batched data is physically transmitted over MQTT.

    config INA219_MQTT_TOPIC
        string "MQTT Telemetry Topic"
        default "robot/telemetry/power"
        help
            Topic name for the InfluxDB Line Protocol power payloads.

endmenu
```

## 01-firmware/ESP32-P4-ETH/components/ina226_sensor/Kconfig
```kconfig
menu "Luloc-ASTI: 2. Sensors - INA226 Power Monitor"

    config INA226_I2C_PORT
        int "I2C Port Number"
        default 0
        help
            The I2C port used to communicate with the INA226.

    config INA226_I2C_SDA_PIN
        int "I2C SDA Pin"
        default 7
        help
            The GPIO mapped to the I2C Data line. 
            Default 7 for ESP32-P4.

    config INA226_I2C_SCL_PIN
        int "I2C SCL Pin"
        default 8
        help
            The GPIO mapped to the I2C Clock line.

    config INA226_I2C_CLOCK_SPEED_HZ
        int "I2C Clock Speed (Hz)"
        default 400000
        help
            I2C Bus speed. Default is 400kHz.

    config INA226_SHUNT_OHMS
        string "Shunt Resistor Value (Ohms)"
        default "0.01"
        help
            Value of the shunt resistor mounted on the INA226 board.
            For 4S LiPo with DC motors, 0.01 ohm for high current.

    config INA226_MAX_EXPECTED_AMPS
        string "Maximum Expected Amps (A)"
        default "10.0"
        help
            Used to calculate the internal LSB scaling for the INA226.
            For a 4S LiPo robot with 2 DC motors, up to 10A burst is realistic.

    config INA226_POLLING_RATE_HZ
        int "Polling Rate in LP Task (Hz)"
        default 5
        help
            How many times per second the low-power CPU reads the sensor
            and updates shared memory.

    config INA226_TELEMETRY_RATE_MS
        int "MQTT Telemetry Rate (ms)"
        default 1000
        help
            How often the batched data is physically transmitted over MQTT.

    config INA226_MQTT_TOPIC
        string "MQTT Telemetry Topic"
        default "robot/telemetry/power"
        help
            Topic name for the InfluxDB Line Protocol power payloads.

endmenu
```

## 01-firmware/ESP32-P4-ETH/components/line_follower_ctrl/Kconfig
```kconfig
menu "Luloc-ASTI: 3. Control & Motors - Line Follower"

    config LINE_FOLLOWER_DEFAULT_KP
        string "Default Proportional Gain (Kp)"
        default "1.5"

    config LINE_FOLLOWER_DEFAULT_KI
        string "Default Integral Gain (Ki)"
        default "0.0"

    config LINE_FOLLOWER_DEFAULT_KD
        string "Default Derivative Gain (Kd)"
        default "0.5"

    config LINE_FOLLOWER_DEFAULT_BASE_SPEED
        string "Default Base Motor Speed"
        default "50.0"

    config LINE_FOLLOWER_DEFAULT_MAX_SPEED
        string "Default Max Motor Speed"
        default "100.0"

    config LINE_FOLLOWER_CAMERA_WEIGHT
        string "Default Camera Curvature Multiplier"
        default "20.0"
        help
            A multiplier applied directly to the camera curvature reading 
            (-1.0 to 1.0) which is then added as feed-forward steering.

endmenu
```

## 01-firmware/ESP32-P4-ETH/components/line_sensor/Kconfig
```kconfig
menu "Lurloc-ASTI: 1. Line Sensor Configuration"

config LINE_SENSOR_ENABLE
    bool "Enable Line Sensor Component"
    default y

config LINE_SENSOR_ADC_UNIT
    int "ADC Unit for Line Sensors"
    default 1
    help
        ADC Unit to use (1 or 2).

config LINE_SENSOR_PIN_IR_EN
    int "Pin IR Emmitters Enable"
    default 5
    help
        GPIO used to turn on the IR LEDs.

# Digital Pins
config LINE_SENSOR_PIN_D1
    int "Pin D1 (Digital)"
    default 1
config LINE_SENSOR_PIN_D2
    int "Pin D2 (Digital)"
    default 2
config LINE_SENSOR_PIN_D7
    int "Pin D7 (Digital)"
    default 7
config LINE_SENSOR_PIN_D8
    int "Pin D8 (Digital)"
    default 8

# Analog Pins (GPIO -> ADC Channel mapping needed)
config LINE_SENSOR_PIN_D3
    int "Pin D3 (Analog GPIO)"
    default 3
config LINE_SENSOR_CHAN_D3
    int "ADC Channel for D3"
    default 3

config LINE_SENSOR_PIN_D4
    int "Pin D4 (Analog GPIO)"
    default 4
config LINE_SENSOR_CHAN_D4
    int "ADC Channel for D4"
    default 4

config LINE_SENSOR_PIN_D5
    int "Pin D5 (Analog GPIO)"
    default 5
config LINE_SENSOR_CHAN_D5
    int "ADC Channel for D5"
    default 5

config LINE_SENSOR_PIN_D6
    int "Pin D6 (Analog GPIO)"
    default 6
config LINE_SENSOR_CHAN_D6
    int "ADC Channel for D6"
    default 6

# Default Calibration
config LINE_SENSOR_DEFAULT_MIN
    int "Default Min ADC Value"
    default 100
config LINE_SENSOR_DEFAULT_MAX
    int "Default Max ADC Value"
    default 4000

# Weights (mm from center)
config LINE_SENSOR_WEIGHT_D1
    int "Weight D1 (mm)"
    default -35
config LINE_SENSOR_WEIGHT_D2
    int "Weight D2 (mm)"
    default -25
config LINE_SENSOR_WEIGHT_D3
    int "Weight D3 (mm)"
    default -15
config LINE_SENSOR_WEIGHT_D4
    int "Weight D4 (mm)"
    default -5
config LINE_SENSOR_WEIGHT_D5
    int "Weight D5 (mm)"
    default 5
config LINE_SENSOR_WEIGHT_D6
    int "Weight D6 (mm)"
    default 15
config LINE_SENSOR_WEIGHT_D7
    int "Weight D7 (mm)"
    default 25
config LINE_SENSOR_WEIGHT_D8
    int "Weight D8 (mm)"
    default 35

endmenu
```

## 01-firmware/ESP32-P4-ETH/components/motor_velocity_ctrl/Kconfig
```kconfig
menu "Luloc-ASTI: 3. Control & Motors - Motor Velocity"

    config VELOCITY_CTRL_DEFAULT_KP
        string "Default Proportional Gain (Kp)"
        default "0.5"

    config VELOCITY_CTRL_DEFAULT_KI
        string "Default Integral Gain (Ki)"
        default "0.1"

    config VELOCITY_CTRL_DEFAULT_KD
        string "Default Derivative Gain (Kd)"
        default "0.05"

    config VELOCITY_CTRL_MAX_BATTERY_MV
        string "Reference Max Battery Voltage (mV)"
        default "16800.0"
        help
            Used for feed-forward calculations. For a 4S Lipo this is 16800mV.
            If the battery drops to 14V, the controller will automatically boost
            the base PWM to match the performance of a 16.8V battery.

    menu "Live Calibration Sweeper"
        config VELOCITY_CTRL_SWEEP_SPEED_1
            string "Sweep Target Speed 1 (m/s)"
            default "0.5"
            help
                First speed step injected when MODE_CALIBRATE_MOTORS is active.

        config VELOCITY_CTRL_SWEEP_SPEED_2
            string "Sweep Target Speed 2 (m/s)"
            default "-0.5"
            help
                Second alternating speed step. Can be negative for reverse testing.

        config VELOCITY_CTRL_SWEEP_TIME_MS
            int "Sweep Step Duration (ms)"
            default 3000
            help
                Time in milliseconds each speed step is maintained before swapping.
    endmenu

    config VELOCITY_CTRL_MAX_MOTOR_SPEED_MS
        string "Max Motor Speed (m/s) at Max Battery Voltage"
        default "1.5"
        help
            Theoretical or measured linear speed (m/s) the robot reaches when 
            exactly Max Battery Voltage (e.g. 16800mV) is applied at 100% PWM.
            This builds the Feed-Forward map.

    config VEL_CTRL_DEADBAND_V
        string "Motor Deadband Voltage (V)"
        default "1.2"
        help
            Minimum voltage required to overcome static friction and start moving.
            This is added as an offset to the controller output.

    config VEL_CTRL_ACCEL_LIMIT
        string "Acceleration Limit (m/s^2)"
        default "2.0"
        help
            Maximum allowed change in target speed per second to protect motors 
            and reduce current spikes.

    config VEL_CTRL_EMA_ALPHA
        string "Encoder EMA Filter Alpha (0.0 - 1.0)"
        default "0.3"
        help
            Smoothing factor for the encoder speed. 
            lower = smoother/delayed, higher = noisier/faster.

endmenu
```

## 01-firmware/ESP32-P4-ETH/components/mqtt_api_responder/Kconfig
```kconfig
menu "[UJI] 3. Comms: MQTT API Responder"

    config MQTT_API_GET_TOPIC
        string "MQTT Subscription Topic for API Requests (GET)"
        default "robot/api/get"
        help
            The component subscribes to this topic to receive JSON queries
            e.g. {"resource": "battery"}

    config MQTT_API_RESP_TOPIC
        string "MQTT Publish Topic for API Responses"
        default "robot/api/response"
        help
            The component will publish the JSON answer to this topic
            e.g. {"battery_mv": 12500, "motor_current_ma": 420.5}

endmenu
```

## 01-firmware/ESP32-P4-ETH/components/mqtt_custom_client/Kconfig.projbuild
```kconfig
menu "MQTT Custom Client Configuration"
    config BROKER_URL
        string "Broker URL"
        default "mqtt://192.168.42.15:51111"
        help
            URL of the mqtt broker to which the esp32 will connect.
            Format: mqtt://host:port or mqtts://host:port for TLS
    
    config BROKER_URL_FROM_STDIN
        bool "Read Broker URL from stdin"
        default n
        help
            If this option is enabled, the broker URL can be input via stdin.
            Useful for testing different brokers without recompilation.
endmenu
```

## 01-firmware/ESP32-P4-ETH/components/pid_tuner/Kconfig
```kconfig
menu "[UJI] 1. Control: Live PID Tuning"

    config PID_TUNER_MQTT_TOPIC
        string "MQTT Topic for Live PID JSON Tuning"
        default "robot/config/pid_motors"
        help
            The component subscribes to this topic to receive JSON payloads
            {"kp":0.5, "ki":0.01, "kd":0.05}

endmenu
```

## 01-firmware/ESP32-P4-ETH/main/Kconfig.projbuild
```kconfig
menu "Luloc-ASTI: 0. Main Configuration"

config ROBOT_USE_ETHERNET
    bool "Enable Ethernet"
    default y

    if ROBOT_USE_ETHERNET
        choice ROBOT_ETH_IP_MODE
            prompt "Ethernet IP Configuration"
            default ROBOT_ETH_DHCP
            help
                Select whether to use DHCP or static IP address

            config ROBOT_ETH_DHCP
                bool "DHCP (automatic IP)"
                help
                    Use DHCP to automatically obtain IP address

            config ROBOT_ETH_STATIC_IP
                bool "Static IP address"
                help
                    Use fixed static IP address
        endchoice

        if ROBOT_ETH_STATIC_IP
            config ROBOT_ETH_STATIC_IP_ADDR
                string "Static IP address"
                default "192.168.42.151"
                help
                    Static IP address (e.g., 192.168.42.151)

            config ROBOT_ETH_STATIC_NETMASK
                string "Netmask"
                default "255.255.255.0"
                help
                    Netmask (e.g., 255.255.255.0)

            config ROBOT_ETH_STATIC_GATEWAY
                string "Gateway"
                default "192.168.42.1"
                help
                    Default gateway (e.g., 192.168.42.1)
        endif
    endif

    config ROBOT_CONTROL_PERIOD_MS
        int "Main Control Loop Period (ms)"
        default 10
        range 1 100
        help
            Period in milliseconds for the main RTOS motor control and PID loop.
            10 ms = 100 Hz, 2 ms = 500 Hz.

    config TELEMETRY_INTERVAL_CALIBRATION_MS
        int "Telemetry: Motor Calibration Interval (ms)"
        default 50
        help
            Publish interval for motor PID calibration metrics (e.g., 20ms = 50Hz)

    config TELEMETRY_INTERVAL_ODOMETRY_MS
        int "Telemetry: Odometry Publish Interval (ms)"
        default 1000
        help
            Frequency to push odometry (X, Y, Theta) data.

    config TELEMETRY_INTERVAL_SYSTEM_MS
        int "Telemetry: System Status Publish Interval (ms)"
        default 5000
        help
            Frequency to push CPU Load and general system heartbeat.


    config LINE_FOLLOWER_DEFAULT_KP
        string "Line Follower: Default Kp"
        default "0.05"
    
    config LINE_FOLLOWER_DEFAULT_KI
        string "Line Follower: Default Ki"
        default "0.0"

    config LINE_FOLLOWER_DEFAULT_KD
        string "Line Follower: Default Kd"
        default "0.01"

    config LINE_FOLLOWER_BASE_SPEED
        string "Line Follower: Base Speed (m/s)"
        default "0.3"

    config LINE_FOLLOWER_FF_WEIGHT
        string "Line Follower: Feed Forward Weight"
        default "1.0"

    config LINE_FOLLOWER_FF_VALUE
        string "Line Follower: Feed Forward Value"
        default "1.0"

endmenu
```

## 01-firmware/ESP32-P4-ETH_uROS/components/mqtt_custom_client/Kconfig.projbuild
```kconfig
menu "Luloc-ASTI: 1. Communications - MQTT Client"
    config BROKER_URL
        string "Broker URL"
        default "mqtt://192.168.42.15:51111"
        help
            URL of the mqtt broker to which the esp32 will connect.
            Format: mqtt://host:port or mqtts://host:port for TLS
endmenu
```
