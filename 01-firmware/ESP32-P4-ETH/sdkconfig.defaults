## 01-firmware/ESP32-P4-ETH_uROS/main/Kconfig.projbuild
```kconfig
menu "micro-ROS example-app (ping-pong) settings"

    config MICRO_ROS_APP_STACK
        int "Stack the micro-ROS app (Bytes)"
        default 16000
        help
        Stack size in Bytes of the micro-ROS app

    config MICRO_ROS_APP_TASK_PRIO
        int "Priority of the micro-ROS app"
        default 5
        help
        Priority of micro-ros task higher value means higher priority
        
endmenu

menu "Luloc-ASTI: 1. Follow Line Configuration"

    config FOLLOW_LINE_KP
        string "Line Follower: Kp (Proportional)"
        default "1.0"
        help
            Proportional gain for the line follower steering PID.

    config FOLLOW_LINE_KI
        string "Line Follower: Ki (Integral)"
        default "0.0"
        help
            Integral gain for the line follower steering PID.

    config FOLLOW_LINE_KD
        string "Line Follower: Kd (Derivative)"
        default "0.1"
        help
            Derivative gain for the line follower steering PID.

    config FOLLOW_LINE_BASE_SPEED
        string "Line Follower: Base Speed (m/s)"
        default "0.4"
        help
            Default straight-line speed for the robot.

    config FOLLOW_LINE_MAX_SPEED
        string "Line Follower: Max Speed (m/s)"
        default "0.8"
        help
            Absolute maximum speed for any motor during steering.

    config FOLLOW_LINE_FF_WEIGHT
        string "Line Follower: FF Weight (0.0 to 1.0)"
        default "0.5"
        help
            Weighting factor for the curvature feed-forward multiplier. 
            0.0 = Ignore FF, 1.0 = Full application of FF.

endmenu
```
